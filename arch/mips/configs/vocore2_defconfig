## arch/mips/configs/vocore2_defconfig
```kconfig
CONFIG_MACH_MIPS_MT7628=y
# CONFIG_GLOBALVAR is not set
CONFIG_STACK_SIZE=0x7000
CONFIG_EXPERIMENTAL=y
CONFIG_PANIC_HANG=y
# CONFIG_BOOTM is not set
CONFIG_CONSOLE_SIMPLE=y
# CONFIG_ENV_HANDLING is not set
CONFIG_POLLER=y
CONFIG_COMPILE_LOGLEVEL=6
CONFIG_DEFAULT_LOGLEVEL=4
CONFIG_DEBUG_LL=y
CONFIG_DEBUG_INITCALLS=y
# CONFIG_SPI is not set
CONFIG_SRAM=y
# CONFIG_FS_RAMFS is not set
# CONFIG_FS_DEVFS is not set
CONFIG_CLOCKSOURCE_DUMMY_RATE=30000
```

## arch/mips/mach-mediatek/Kconfig
```kconfig
if MACH_MIPS_MT7628

config ARCH_TEXT_BASE
	hex
	default 0xa0800000

choice
	prompt "Board type"

config BOARD_VONGER_VOCORE2
	bool "Vonger VoCore2"
	select HAVE_PBL_IMAGE
	select HAVE_IMAGE_COMPRESSION
	select OFDEVICE

endchoice

endif
```
